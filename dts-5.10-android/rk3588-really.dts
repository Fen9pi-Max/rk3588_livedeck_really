// SPDX-License-Identifier: (GPL-2.0+ OR MIT)
/*
 * Really TVI2340R RK3588 live-streaming box, vendor 5.10/6.1.
 *
 * Derived from the factory Android 12 / vendor 5.10 DTB.
 * The built-in panel is driven by DSI1 and scanned at 1920x1080.
 * Source SHA256: d516e8f62ce040e76cab2cbc394dbe46ab53f3f82e9cec1ed8e5714f51358521
 */

/dts-v1/;

#include <dt-bindings/clock/rk3588-cru.h>
#include <dt-bindings/gpio/gpio.h>
#include <dt-bindings/input/linux-event-codes.h>
#include <dt-bindings/interrupt-controller/arm-gic.h>
#include <dt-bindings/interrupt-controller/irq.h>
#include <dt-bindings/leds/common.h>
#include <dt-bindings/power/rk3588-power.h>
#include <dt-bindings/pinctrl/rockchip.h>
#include <dt-bindings/pwm/pwm.h>
#include "rk3588.dtsi"
#include "rk3588-rk806-single.dtsi"
#include "rk3588-android.dtsi"

/ {
	model = "Really TVI2340R RK3588 Live Streaming Box";

	compatible = "rockchip,rk3588-tvi2340r", "rockchip,rk3588";

	adc_keys: adc-keys {
		compatible = "adc-keys";
		io-channels = <&saradc 1>;
		io-channel-names = "buttons";
		keyup-threshold-microvolt = <1800000>;
		poll-interval = <100>;

		back-key {
			label = "back";
			linux,code = <KEY_BACK>;
			press-threshold-microvolt = <1235000>;
		};

		menu-key {
			label = "menu";
			linux,code = <KEY_MENU>;
			press-threshold-microvolt = <890000>;
		};

		vol-down-key {
			label = "volume down";
			linux,code = <KEY_VOLUMEDOWN>;
			press-threshold-microvolt = <417000>;
		};

		vol-up-key {
			label = "volume up";
			linux,code = <KEY_VOLUMEUP>;
			press-threshold-microvolt = <17000>;
		};
	};

	aliases {
		mmc0 = &sdhci;
		mmc1 = &sdmmc;
		serial2 = &uart2;
	};

	backlight_lvds: backlight-lvds {
		compatible = "pwm-backlight";
		status = "okay";
		brightness-levels = <0 20 20 21 21 22 22 23 23 24 24 25 25 26 26 27
				     27 28 28 29 29 30 30 31 31 32 32 33 33 34 34 35
				     35 36 36 37 37 38 38 39 40 41 42 43 44 45 46 47
				     48 49 50 51 52 53 54 55 56 57 58 59 60 61 62 63
				     64 65 66 67 68 69 70 71 72 73 74 75 76 77 78 79
				     80 81 82 83 84 85 86 87 88 89 90 91 92 93 94 95
				     96 97 98 99 100 101 102 103 104 105 106 107 108 109 110 111
				     112 113 114 115 116 117 118 119 120 121 122 123 124 125 126 127
				     128 129 130 131 132 133 134 135 136 137 138 139 140 141 142 143
				     144 145 146 147 148 149 150 151 152 153 154 155 156 157 158 159
				     160 161 162 163 164 165 166 167 168 169 170 171 172 173 174 175
				     176 177 178 179 180 181 182 183 184 185 186 187 188 189 190 191
				     192 193 194 195 196 197 198 199 200 201 202 203 204 205 206 207
				     208 209 210 211 212 213 214 215 216 217 218 219 220 221 222 223
				     224 225 226 227 228 229 230 231 232 233 234 235 236 237 238 239
				     240 241 242 243 244 245 246 247 248 249 250 251 252 253 254 255>;
		default-brightness-level = <102>;
		power-supply = <&vcc_3v3_s3>;
		pwms = <&pwm12 0 1000000 0>;
	};

	backlight_edp: backlight-edp {
		compatible = "pwm-backlight";
		power-supply = <&vcc_3v3_s3>;
		pwms = <&pwm6 0 25000 0>;
		post-pwm-on-delay-ms = <100>;
		brightness-levels = <0 20 20 21 21 22 22 23 23 24 24 25 25 26 26 27
				     27 28 28 29 29 30 30 31 31 32 32 33 33 34 34 35
				     35 36 36 37 37 38 38 39 40 41 42 43 44 45 46 47
				     48 49 50 51 52 53 54 55 56 57 58 59 60 61 62 63
				     64 65 66 67 68 69 70 71 72 73 74 75 76 77 78 79
				     80 81 82 83 84 85 86 87 88 89 90 91 92 93 94 95
				     96 97 98 99 100 101 102 103 104 105 106 107 108 109 110 111
				     112 113 114 115 116 117 118 119 120 121 122 123 124 125 126 127
				     128 129 130 131 132 133 134 135 136 137 138 139 140 141 142 143
				     144 145 146 147 148 149 150 151 152 153 154 155 156 157 158 159
				     160 161 162 163 164 165 166 167 168 169 170 171 172 173 174 175
				     176 177 178 179 180 181 182 183 184 185 186 187 188 189 190 191
				     192 193 194 195 196 197 198 199 200 201 202 203 204 205 206 207
				     208 209 210 211 212 213 214 215 216 217 218 219 220 221 222 223
				     224 225 226 227 228 229 230 231 232 233 234 235 236 237 238 239
				     240 241 242 243 244 245 246 247 248 249 250 251 252 253 254 255>;
		default-brightness-level = <102>;
		enable-gpios = <&gpio4 RK_PB6 GPIO_ACTIVE_HIGH>;
		pinctrl-names = "default";
		pinctrl-0 = <&edp_bl_en>;
	};

	chosen {
		stdout-path = "serial2:1500000n8";
	};

	es8388_sound: es8388-sound {
		status = "okay";
		compatible = "rockchip,multicodecs-card";
		hp-det-gpio = <&gpio4 RK_PB3 GPIO_ACTIVE_HIGH>;
		hp-con-gpio = <&gpio4 RK_PB4 GPIO_ACTIVE_HIGH>;
		linein-det-gpio = <&gpio1 RK_PB6 GPIO_ACTIVE_HIGH>;
		io-channels = <&saradc 3>;
		io-channel-names = "adc-detect";
		keyup-threshold-microvolt = <1800000>;
		poll-interval = <100>;
		rockchip,audio-routing = "Headphone", "LOUT1",
			"Headphone", "ROUT1",
			"Speaker", "LOUT2",
			"Speaker", "ROUT2",
			"Headphone", "Headphone Power",
			"Headphone", "Headphone Power",
			"Speaker", "Speaker Power",
			"Speaker", "Speaker Power",
			"LINPUT1", "Main Mic",
			"LINPUT2", "Main Mic",
			"RINPUT1", "Headset Mic",
			"RINPUT2", "Headset Mic";
		rockchip,card-name = "rockchip-es8388";
		rockchip,codec = <&es8388>;
		rockchip,cpu = <&i2s1_8ch>;
		rockchip,format = "i2s";
		rockchip,mclk-fs = <256>;
		spk-con-gpio = <&gpio4 RK_PB2 GPIO_ACTIVE_LOW>;
		pinctrl-names = "default";
		pinctrl-0 = <&hp_det &spk_ctrl &hp_con &linein_det>;

		play-pause-key {
			label = "playpause";
			linux,code = <KEY_PLAYPAUSE>;
			press-threshold-microvolt = <200000>;
		};
	};

	ext_cam_clk: external-camera-clock {
		compatible = "fixed-clock";
		clock-frequency = <27000000>;
		clock-output-names = "CLK_CAMERA_27MHZ";
		#clock-cells = <0>;
	};

	hdmi1-con {
		compatible = "hdmi-connector";
		type = "a";

		port {
			hdmi1_con_in: endpoint {
				remote-endpoint = <&hdmi1_out_con>;
			};
		};
	};

	hdmi1_sound: hdmi1-sound {
		status = "okay";
		compatible = "rockchip,hdmi";
		rockchip,card-name = "rockchip-hdmi1";
		rockchip,codec = <&hdmi1>;
		rockchip,cpu = <&i2s6_8ch>;
		rockchip,mclk-fs = <128>;
		rockchip,jack-det;
	};

	hdmiin_dc: hdmiin-dc {
		compatible = "rockchip,dummy-codec";
		#sound-dai-cells = <0>;
	};

	hdmiin_sound: hdmiin-sound {
		compatible = "simple-audio-card";
		simple-audio-card,format = "i2s";
		simple-audio-card,name = "rockchip,hdmiin";
		simple-audio-card,bitclock-master = <&hdmiin_dc>;
		simple-audio-card,frame-master = <&hdmiin_dc>;
		status = "okay";

		simple-audio-card,cpu {
			sound-dai = <&i2s7_8ch>;
		};

		simple-audio-card,codec {
			sound-dai = <&hdmiin_dc>;
		};
	};

	leds: leds {
		status = "disabled";
		compatible = "gpio-leds";

		work {
			gpios = <&gpio3 RK_PB7 GPIO_ACTIVE_HIGH>;
			linux,default-trigger = "heartbeat";
		};
	};

	panel_edp0: panel-edp0 {
		compatible = "simple-panel";
		backlight = <&backlight_edp>;
		power-supply = <&vcc_3v3_s3>;
		enable-gpios = <&gpio1 RK_PD0 GPIO_ACTIVE_HIGH>;
		pinctrl-names = "default";
		pinctrl-0 = <&edp_en>;
		prepare-delay-ms = <120>;
		enable-delay-ms = <120>;
		unprepare-delay-ms = <120>;
		disable-delay-ms = <120>;

		port {
			panel_in_edp0: endpoint {
				remote-endpoint = <&edp0_out_panel>;
			};
		};
	};

	dummy_codec: dummy-codec {
		status = "okay";
		compatible = "rockchip,dummy-codec";
		#sound-dai-cells = <0>;
	};

	pdm_mic_array: pdm-mic-array {
		status = "okay";
		compatible = "simple-audio-card";
		simple-audio-card,name = "rockchip,pdm-mic-array";

		simple-audio-card,cpu {
			sound-dai = <&pdm0>;
		};

		simple-audio-card,codec {
			sound-dai = <&dummy_codec>;
		};
	};

	/*
	 * Switched 1.8V module rail on GPIO0_C0.  The factory keeps it
	 * always-on.  GT9110 (VDDIO) and the HYM8563 RTC carry no supply
	 * property of their own -- they depend entirely on this rail being
	 * up.  The pinctrl group is mandatory: without it the pin is never
	 * actually driven and both devices stay dead.
	 */
	vcc1v8_sys: regulator-vcc1v8-sys {
		compatible = "regulator-fixed";
		enable-active-high;
		gpio = <&gpio0 RK_PC0 GPIO_ACTIVE_HIGH>;
		pinctrl-names = "default";
		pinctrl-0 = <&vcc1v8_sys_en>;
		regulator-name = "vcc1v8_sys";
		regulator-min-microvolt = <1800000>;
		regulator-max-microvolt = <1800000>;
		regulator-always-on;
		regulator-boot-on;
	};

	vcc1v8_pmu_ddr_s3: regulator-vcc1v8-pmu-ddr-s3 {
		compatible = "regulator-fixed";
		regulator-name = "vcc1v8_pmu_ddr_s3";
		regulator-always-on;
		regulator-boot-on;
		regulator-min-microvolt = <1800000>;
		regulator-max-microvolt = <1800000>;
	};

	pcie20_avdd0v85: regulator-pcie20-avdd0v85 {
		compatible = "regulator-fixed";
		regulator-name = "pcie20_avdd0v85";
		regulator-always-on;
		regulator-boot-on;
		regulator-min-microvolt = <850000>;
		regulator-max-microvolt = <850000>;
	};

	pcie20_avdd1v8: regulator-pcie20-avdd1v8 {
		compatible = "regulator-fixed";
		regulator-name = "pcie20_avdd1v8";
		regulator-always-on;
		regulator-boot-on;
		regulator-min-microvolt = <1800000>;
		regulator-max-microvolt = <1800000>;
	};

	pcie30_avdd0v75: regulator-pcie30-avdd0v75 {
		compatible = "regulator-fixed";
		regulator-name = "pcie30_avdd0v75";
		regulator-always-on;
		regulator-boot-on;
		regulator-min-microvolt = <750000>;
		regulator-max-microvolt = <750000>;
	};

	pcie30_avdd1v8: regulator-pcie30-avdd1v8 {
		compatible = "regulator-fixed";
		regulator-name = "pcie30_avdd1v8";
		regulator-always-on;
		regulator-boot-on;
		regulator-min-microvolt = <1800000>;
		regulator-max-microvolt = <1800000>;
	};

	/*
	 * GPIO1_D0 enables the touch module AND the panel together.  Keep it
	 * as a standalone always-on regulator instead of hanging it off the
	 * eDP panel, so disabling eDP (this assembly has no eDP panel) cannot
	 * take the touchscreen down with it.
	 */
	touch_panel_pwr: regulator-touch-panel-pwr {
		compatible = "regulator-fixed";
		enable-active-high;
		gpio = <&gpio1 RK_PD0 GPIO_ACTIVE_HIGH>;
		pinctrl-names = "default";
		pinctrl-0 = <&touch_panel_en>;
		regulator-name = "touch_panel_pwr";
		regulator-always-on;
		regulator-boot-on;
	};

	vcc_1v1_nldo_s3: regulator-vcc-1v1-nldo-s3 {
		compatible = "regulator-fixed";
		regulator-name = "vcc_1v1_nldo_s3";
		regulator-always-on;
		regulator-boot-on;
		regulator-min-microvolt = <1100000>;
		regulator-max-microvolt = <1100000>;
		vin-supply = <&vcc4v0_sys>;
	};

	vcc12v_dcin: regulator-vcc12v-dcin {
		compatible = "regulator-fixed";
		regulator-name = "vcc12v_dcin";
		regulator-always-on;
		regulator-boot-on;
		regulator-min-microvolt = <12000000>;
		regulator-max-microvolt = <12000000>;
	};

	vcc5v0_sys: regulator-vcc5v0-sys {
		compatible = "regulator-fixed";
		regulator-name = "vcc5v0_sys";
		regulator-always-on;
		regulator-boot-on;
		regulator-min-microvolt = <5000000>;
		regulator-max-microvolt = <5000000>;
		vin-supply = <&vcc12v_dcin>;
	};

	vcc4v0_sys: regulator-vcc4v0-sys {
		compatible = "regulator-fixed";
		regulator-name = "vcc4v0_sys";
		regulator-always-on;
		regulator-boot-on;
		regulator-min-microvolt = <4000000>;
		regulator-max-microvolt = <4000000>;
		vin-supply = <&vcc12v_dcin>;
	};

	vcc3v3_ext: regulator-vcc3v3-ext {
		compatible = "regulator-fixed";
		regulator-name = "vcc3v3_ext";
		regulator-boot-on;
		regulator-always-on;
		regulator-min-microvolt = <3300000>;
		regulator-max-microvolt = <3300000>;
		vin-supply = <&vcc5v0_sys>;
	};

	vcc3v3_pcie: regulator-vcc3v3-pcie {
		compatible = "regulator-fixed";
		regulator-name = "vcc3v3_pcie";
		regulator-boot-on;
		regulator-always-on;
		regulator-min-microvolt = <3300000>;
		regulator-max-microvolt = <3300000>;
		gpio = <&gpio3 RK_PB3 GPIO_ACTIVE_HIGH>;
		enable-active-high;
		vin-supply = <&vcc3v3_ext>;
		pinctrl-names = "default";
		pinctrl-0 = <&vcc3v3_pcie_en>;
	};

	vcc5v0_usb: regulator-vcc5v0-usb {
		compatible = "regulator-fixed";
		regulator-name = "vcc5v0_usb";
		regulator-boot-on;
		regulator-always-on;
		regulator-min-microvolt = <5000000>;
		regulator-max-microvolt = <5000000>;
		gpio = <&gpio4 RK_PA6 GPIO_ACTIVE_HIGH>;
		enable-active-high;
		vin-supply = <&vcc5v0_sys>;
		pinctrl-names = "default";
		pinctrl-0 = <&vcc5v0_usb_en>;
	};

	vcc5v0_host: regulator-vcc5v0-host {
		compatible = "regulator-fixed";
		regulator-name = "vcc5v0_host";
		regulator-boot-on;
		regulator-always-on;
		regulator-min-microvolt = <5000000>;
		regulator-max-microvolt = <5000000>;
		gpio = <&gpio3 RK_PA5 GPIO_ACTIVE_HIGH>;
		enable-active-high;
		vin-supply = <&vcc5v0_sys>;
		pinctrl-names = "default";
		pinctrl-0 = <&vcc5v0_host_en>;
	};

	vbus5v0_typec: regulator-vbus5v0-typec {
		compatible = "regulator-fixed";
		regulator-name = "vbus5v0_typec";
		regulator-min-microvolt = <5000000>;
		regulator-max-microvolt = <5000000>;
		gpio = <&gpio1 RK_PD1 GPIO_ACTIVE_HIGH>;
		enable-active-high;
		vin-supply = <&vcc5v0_sys>;
		pinctrl-names = "default";
		pinctrl-0 = <&typec5v_pwren>;
	};

	vcc_sd: regulator-vcc-sd {
		compatible = "regulator-fixed";
		regulator-name = "vcc_sd";
		regulator-min-microvolt = <3300000>;
		regulator-max-microvolt = <3300000>;
		gpio = <&gpio4 RK_PC3 GPIO_ACTIVE_HIGH>;
		enable-active-high;
		startup-delay-us = <100000>;
		vin-supply = <&vcc_3v3_s3>;
		pinctrl-names = "default";
		pinctrl-0 = <&sdmmc_pwr>;
	};

	lvds_pwr_en: regulator-lvds-pwr-en {
		compatible = "regulator-fixed";
		regulator-name = "lvds_pwr_en";
		regulator-boot-on;
		regulator-always-on;
		gpio = <&gpio3 RK_PB6 GPIO_ACTIVE_HIGH>;
		enable-active-high;
		pinctrl-names = "default";
		pinctrl-0 = <&lvds_pwren_pin>;
	};

	vcc_5g_module_rst: regulator-vcc-5g-module-rst {
		compatible = "regulator-fixed";
		regulator-name = "vcc_5g_module_rst";
		regulator-boot-on;
		regulator-always-on;
		gpio = <&gpio2 RK_PC5 GPIO_ACTIVE_HIGH>;
		enable-active-high;
		pinctrl-names = "default";
		pinctrl-0 = <&vcc_5g_module_rst_pin>;
	};

	vcc_5g_dpr_ctl: regulator-vcc-5g-dpr-ctl {
		compatible = "regulator-fixed";
		regulator-name = "vcc_5g_dpr_ctl";
		gpio = <&gpio3 RK_PD5 GPIO_ACTIVE_HIGH>;
		enable-active-high;
		pinctrl-names = "default";
		pinctrl-0 = <&vcc_5g_dpr_ctrl_pin>;
	};

	power_on_led: regulator-power-on-led {
		compatible = "regulator-fixed";
		regulator-name = "power_on_led";
		regulator-state-disabled;
		gpio = <&gpio3 RK_PD0 GPIO_ACTIVE_HIGH>;
		enable-active-high;
		pinctrl-names = "default";
		pinctrl-0 = <&led_power_on>;
	};

	fan: tv-pwm-fan {
		status = "okay";
		compatible = "techvision,pwm_fan";
		pwms = <&pwm2 0 40000 PWM_POLARITY_INVERTED>;
		cooling-levels = <0 76 153 204>;
	};

	mipi_cam_pwen: regulator-mipi-cam-pwen {
		compatible = "regulator-fixed";
		regulator-name = "mipi_cam_pwen";
		regulator-always-on;
		regulator-boot-on;
		gpio = <&gpio1 RK_PA2 GPIO_ACTIVE_HIGH>;
		enable-active-high;
		pinctrl-names = "default";
		pinctrl-0 = <&camera_pwen>;
	};

	vcc28_dvp: regulator-vcc28-dvp {
		compatible = "regulator-fixed";
		regulator-name = "vcc28_dvp";
		regulator-always-on;
		regulator-boot-on;
		regulator-min-microvolt = <2800000>;
		regulator-max-microvolt = <2800000>;
	};

	vcc12_dvp: regulator-vcc12-dvp {
		compatible = "regulator-fixed";
		regulator-name = "vcc12_dvp";
		regulator-always-on;
		regulator-boot-on;
		regulator-min-microvolt = <1200000>;
		regulator-max-microvolt = <1200000>;
	};

/*
 * Really carries an SGM760B-style external watchdog on GPIO0_D3.  The
 * factory DTB keeps both this device and the RK3588 DW watchdog disabled.
 */
	watchdog_ext: watchdog-gpio {
		compatible = "linux,wdt-gpio";
		gpios = <&gpio0 RK_PD3 GPIO_ACTIVE_HIGH>;
		pinctrl-names = "default";
		pinctrl-0 = <&sgm760b_power>;
		hw_algo = "level";
		hw_margin_ms = <500>;
		always-running;
		status = "disabled";
	};

	wireless_bluetooth: wireless-bluetooth {
		compatible = "bluetooth-platdata";
		clocks = <&hym8563>;
		clock-names = "ext_clock";
		uart_rts_gpios = <&gpio3 RK_PC2 GPIO_ACTIVE_LOW>;
		pinctrl-names = "default", "rts_gpio";
		pinctrl-0 = <&uart7m1_rtsn &bt_reset_gpio &bt_wake_gpio &bt_wake_host_irq>;
		pinctrl-1 = <&uart7_gpios>;
		BT,reset_gpio = <&gpio0 RK_PC6 GPIO_ACTIVE_HIGH>;
		BT,wake_gpio = <&gpio0 RK_PC5 GPIO_ACTIVE_HIGH>;
		BT,wake_host_irq = <&gpio0 RK_PA0 GPIO_ACTIVE_HIGH>;
		status = "okay";
	};

	wireless_wlan: wireless-wlan {
		compatible = "wlan-platdata";
		wifi_chip_type = "ap6275p";
		pinctrl-names = "default";
		pinctrl-0 = <&wifi_host_wake_irq &wifi_poweren_gpio>;
		WIFI,host_wake_irq = <&gpio0 RK_PB2 GPIO_ACTIVE_HIGH>;
		WIFI,poweren_gpio = <&gpio0 RK_PC4 GPIO_ACTIVE_HIGH>;
		status = "okay";
	};
};

&av1d {
	status = "okay";
};

&av1d_mmu {
	status = "okay";
};

&combphy0_ps {
	status = "okay";
};

&combphy2_psu {
	status = "okay";
};

&cpu_b0 {
	cpu-supply = <&vdd_cpu_big0_s0>;
	mem-supply = <&vdd_cpu_big0_s0>;
};

&cpu_b1 {
	cpu-supply = <&vdd_cpu_big0_s0>;
	mem-supply = <&vdd_cpu_big0_s0>;
};

&cpu_b2 {
	cpu-supply = <&vdd_cpu_big1_s0>;
	mem-supply = <&vdd_cpu_big1_s0>;
};

&cpu_b3 {
	cpu-supply = <&vdd_cpu_big1_s0>;
	mem-supply = <&vdd_cpu_big1_s0>;
};

&cpu_l0 {
	cpu-supply = <&vdd_cpu_lit_s0>;
	mem-supply = <&vdd_cpu_lit_mem_s0>;
};

&cpu_l1 {
	cpu-supply = <&vdd_cpu_lit_s0>;
	mem-supply = <&vdd_cpu_lit_mem_s0>;
};

&cpu_l2 {
	cpu-supply = <&vdd_cpu_lit_s0>;
	mem-supply = <&vdd_cpu_lit_mem_s0>;
};

&cpu_l3 {
	cpu-supply = <&vdd_cpu_lit_s0>;
	mem-supply = <&vdd_cpu_lit_mem_s0>;
};

&csi2_dcphy0 {
	status = "okay";

	ports {
		#address-cells = <1>;
		#size-cells = <0>;

		port@0 {
			reg = <0>;
			#address-cells = <1>;
			#size-cells = <0>;

			mipi_in_ucam0: endpoint@1 {
				reg = <1>;
				remote-endpoint = <&imx577_out>;
				data-lanes = <1 2 3 4>;
			};
		};

		port@1 {
			reg = <1>;
			#address-cells = <1>;
			#size-cells = <0>;

			dcphy0_out: endpoint@0 {
				reg = <0>;
				remote-endpoint = <&mipi0_csi2_input>;
			};
		};
	};
};

&csi2_dphy0 {
	status = "okay";
	rockchip,hw = <&csi2_dphy0_hw>;

	ports {
		#address-cells = <1>;
		#size-cells = <0>;

		port@0 {
			#address-cells = <1>;
			#size-cells = <0>;
			reg = <0>;

			mipidphy0_in_lt6911: endpoint@1 {
				reg = <1>;
				data-lanes = <1 2 3 4>;
				remote-endpoint = <&lt6911_out>;
			};
		};

		port@1 {
			#address-cells = <1>;
			#size-cells = <0>;
			reg = <1>;

			csidphy0_out: endpoint@0 {
				reg = <0>;
				remote-endpoint = <&mipi2_csi2_input>;
			};
		};
	};
};

&dp0 {
	status = "okay";
};

&dp0_in_vp1 {
	status = "okay";
};

&dsi1 {
	status = "okay";

	ports {
		#address-cells = <1>;
		#size-cells = <0>;

		port@1 {
			reg = <1>;

			dsi1_out_panel: endpoint {
				remote-endpoint = <&panel_in_dsi1>;
			};
		};
	};

	panel@0 {
		compatible = "simple-panel-dsi";
		reg = <0>;
		status = "okay";
		uboot_bridge = <1>;
		reset-delay-ms = <10>;
		enable-delay-ms = <10>;
		prepare-delay-ms = <10>;
		unprepare-delay-ms = <10>;
		disable-delay-ms = <10>;
		dsi,flags = <0x803>;
		dsi,format = <0>;
		dsi,lanes = <4>;
		panel-init-sequence = <0x05780111 0x05000129>;
		panel-exit-sequence = <0x05000128 0x05000110>;

		display-timings {
			native-mode = <&dsi1_timing0>;

			dsi1_timing0: timing0 {
				clock-frequency = <148500000>;
				hactive = <1920>;
				vactive = <1080>;
				hfront-porch = <88>;
				hsync-len = <44>;
				hback-porch = <148>;
				vfront-porch = <4>;
				vsync-len = <5>;
				vback-porch = <36>;
				hsync-active = <1>;
				vsync-active = <1>;
				de-active = <0>;
				pixelclk-active = <0>;
			};
		};

		ports {
			#address-cells = <1>;
			#size-cells = <0>;

			port@0 {
				reg = <0>;

				panel_in_dsi1: endpoint {
					remote-endpoint = <&dsi1_out_panel>;
				};
			};
		};
	};
};

&dsi1_in_vp3 {
	status = "okay";
};

&edp0 {
	status = "okay";

	ports {
		#address-cells = <1>;
		#size-cells = <0>;

		port@1 {
			reg = <1>;

			edp0_out_panel: endpoint {
				remote-endpoint = <&panel_in_edp0>;
			};
		};
	};
};

&edp0_in_vp2 {
	status = "okay";
};

&gmac0 {
	clock_in_out = "output";
	phy-handle = <&rgmii_phy0>;
	phy-mode = "rgmii-rxid";
	pinctrl-names = "default";
	pinctrl-0 = <&gmac0_miim
		     &gmac0_tx_bus2
		     &gmac0_rx_bus2
		     &gmac0_rgmii_clk
		     &gmac0_rgmii_bus>;
	snps,reset-active-low;
	snps,reset-delays-us = <0 20000 100000>;
	snps,reset-gpio = <&gpio2 RK_PC4 GPIO_ACTIVE_LOW>;
	status = "okay";
	tx_delay = <0x44>;
};

&gpu {
	mali-supply = <&vdd_gpu_s0>;
	mem-supply = <&vdd_gpu_mem_s0>;
	status = "okay";
};

&hdmi1 {
	pinctrl-names = "default";
	pinctrl-0 = <&hdmim2_tx1_cec &hdmim0_tx1_hpd
		     &hdmim1_tx1_scl &hdmim1_tx1_sda>;
	enable-gpios = <&gpio3 RK_PC5 GPIO_ACTIVE_HIGH>;
	status = "okay";

	ports {
		#address-cells = <1>;
		#size-cells = <0>;

		port@1 {
			reg = <1>;

			hdmi1_out_con: endpoint {
				remote-endpoint = <&hdmi1_con_in>;
			};
		};
	};
};

&hdmi1_in_vp0 {
	status = "okay";
};

&hdmirx_ctrler {
	hpd-trigger-level = <1>;
	hdmirx-det-gpios = <&gpio4 RK_PC6 GPIO_ACTIVE_LOW>;
	pinctrl-names = "default";
	pinctrl-0 = <&hdmim1_rx &hdmirx_det>;
	status = "okay";
};

&hdptxphy0 {
	status = "okay";
};

&hdptxphy1 {
	status = "okay";
};

&hdptxphy_hdmi0 {
	status = "okay";
};

&hdptxphy_hdmi1 {
	status = "okay";
};

&i2c0 {
	pinctrl-names = "default";
	pinctrl-0 = <&i2c0m2_xfer>;
	status = "okay";

	vdd_cpu_big0_s0: regulator@42 {
		compatible = "rockchip,rk8602";
		reg = <0x42>;
		fcs,suspend-voltage-selector = <1>;
		regulator-name = "vdd_cpu_big0_s0";
		regulator-always-on;
		regulator-boot-on;
		regulator-min-microvolt = <550000>;
		regulator-max-microvolt = <1050000>;
		regulator-ramp-delay = <2300>;
		vin-supply = <&vcc5v0_sys>;
	};

	vdd_cpu_big1_s0: regulator@43 {
		compatible = "rockchip,rk8603", "rockchip,rk8602";
		reg = <0x43>;
		fcs,suspend-voltage-selector = <1>;
		regulator-name = "vdd_cpu_big1_s0";
		regulator-always-on;
		regulator-boot-on;
		regulator-min-microvolt = <550000>;
		regulator-max-microvolt = <1050000>;
		regulator-ramp-delay = <2300>;
		vin-supply = <&vcc5v0_sys>;
	};
};

&i2c1 {
	pinctrl-names = "default";
	pinctrl-0 = <&i2c1m2_xfer>;
	status = "okay";

	vdd_npu_s0: regulator@42 {
		compatible = "rockchip,rk8602";
		reg = <0x42>;
		fcs,suspend-voltage-selector = <1>;
		regulator-name = "vdd_npu_s0";
		regulator-always-on;
		regulator-boot-on;
		regulator-min-microvolt = <550000>;
		regulator-max-microvolt = <950000>;
		regulator-ramp-delay = <2300>;
		vin-supply = <&vcc5v0_sys>;
	};
};

&i2c3 {
	clock-frequency = <100000>;
	pinctrl-names = "default";
	pinctrl-0 = <&i2c3m0_xfer>;
	status = "okay";

	es8388: es8388@11 {
		compatible = "everest,es8388", "everest,es8323";
		reg = <0x11>;
		#sound-dai-cells = <0>;
		clocks = <&cru I2S1_8CH_MCLKOUT>;
		clock-names = "mclk";
		assigned-clocks = <&cru I2S1_8CH_MCLKOUT>;
		assigned-clock-rates = <12288000>;
		pinctrl-names = "default";
		pinctrl-0 = <&i2s1m0_mclk>;
	};
};

&i2c4 {
	clock-frequency = <400000>;
	pinctrl-names = "default";
	pinctrl-0 = <&i2c4m1_xfer>;
	status = "okay";

	lt9211: lt9211@2d {
		compatible = "lontium,lt9211";
		reg = <0x2d>;
		status = "okay";
		backlight = <&backlight_lvds>;
		reset-delay-ms = <20>;
		io-channels = <&saradc 2>, <&saradc 4>, <&saradc 6>, <&saradc 7>;
		io-channel-names = "adc-switch";
		lt9211,mipi-in-port = <0>;
		lt9211,output-mode = <3>;
		lt9211,input-mode = <0>;
		lt9211,backlight-gpio = <&gpio3 RK_PB4 GPIO_ACTIVE_HIGH>;
		lt9211,reset-gpio = <&gpio3 RK_PA6 GPIO_ACTIVE_HIGH>;
		pinctrl-names = "default";
		pinctrl-0 = <&lt9211_gpio>;
	};

	gt9xx: gt9xx@14 {
		status = "okay";
		compatible = "goodix,gt9xx";
		reg = <0x14>;
		AVDD28-supply = <&vcc28_dvp>;
		VDDIO-supply = <&vcc1v8_sys>;
		reset-gpio = <&gpio1 RK_PD3 GPIO_ACTIVE_LOW>;
		touch-gpio = <&gpio4 RK_PB0 GPIO_ACTIVE_LOW>;
		pinctrl-names = "default";
		pinctrl-0 = <&gt9xx_gpios>;
		max-x = <1920>;
		max-y = <1080>;
		tp-size = <9110>;
	};

	hym8563: rtc@51 {
		compatible = "haoyu,hym8563";
		reg = <0x51>;
		#clock-cells = <0>;
		clock-frequency = <32768>;
		clock-output-names = "hym8563";
		interrupt-parent = <&gpio0>;
		interrupts = <RK_PB0 IRQ_TYPE_LEVEL_LOW>;
		pinctrl-names = "default";
		pinctrl-0 = <&hym8563_int>;
		wakeup-source;
	};

	eeprom: eeprom@56 {
		compatible = "atmel,24c04";
		reg = <0x56>;
		pagesize = <16>;
		status = "okay";
	};

	imx577: imx577@1a {
		status = "okay";
		compatible = "sony,imx577";
		reg = <0x1a>;
		clocks = <&cru CLK_MIPI_CAMARAOUT_M3>;
		clock-names = "xvclk";
		pinctrl-names = "default";
		pinctrl-0 = <&mipim0_camera3_clk &camera_pdn &camera_rst>;
		avdd-supply = <&vcc28_dvp>;
		dovdd-supply = <&vcc_1v8_s3>;
		dvdd-supply = <&vcc12_dvp>;
		power-domains = <&power RK3588_PD_VI>;
		pwdn-gpios = <&gpio1 RK_PB0 GPIO_ACTIVE_HIGH>;
		reset-gpios = <&gpio1 RK_PB1 GPIO_ACTIVE_LOW>;
		rockchip,camera-module-index = <0>;
		rockchip,camera-module-facing = "back";
		rockchip,camera-module-name = "default";
		rockchip,camera-module-lens-name = "default";

		port {
			imx577_out: endpoint {
				remote-endpoint = <&mipi_in_ucam0>;
				data-lanes = <1 2 3 4>;
			};
		};
	};
};

&i2c6 {
	pinctrl-names = "default";
	pinctrl-0 = <&i2c6m0_xfer>;
	status = "okay";

	lt6911: lt6911@2b {
		compatible = "lontium,lt6911uxc2";
		reg = <0x2b>;
		clocks = <&ext_cam_clk>;
		clock-names = "xvclk";
		interrupt-parent = <&gpio1>;
		interrupts = <RK_PC7 IRQ_TYPE_LEVEL_LOW>;
		reset-gpios = <&gpio3 RK_PA7 GPIO_ACTIVE_HIGH>;
		hpd-ctl-gpios = <&gpio2 RK_PC3 GPIO_ACTIVE_HIGH>;
		pinctrl-names = "default";
		pinctrl-0 = <&lt6911_pins>;
		power-domains = <&power RK3588_PD_VI>;
		rockchip,camera-module-index = <1>;
		rockchip,camera-module-facing = "back";
		rockchip,camera-module-name = "lt6911uxc2";
		rockchip,camera-module-lens-name = "NC";
		status = "okay";

		port {
			lt6911_out: endpoint {
				data-lanes = <1 2 3 4>;
				remote-endpoint = <&mipidphy0_in_lt6911>;
			};
		};
	};

	usbc0: husb311@4e {
		compatible = "hynetek,husb311";
		reg = <0x4e>;
		status = "okay";
		interrupt-parent = <&gpio0>;
		interrupts = <RK_PB7 IRQ_TYPE_LEVEL_LOW>;
		pinctrl-names = "default";
		pinctrl-0 = <&usbc0_int>;
		vbus-supply = <&vbus5v0_typec>;

		ports {
			#address-cells = <1>;
			#size-cells = <0>;

			port@0 {
				reg = <0>;

				usbc0_role_sw: endpoint@0 {
					reg = <0>;
					remote-endpoint = <&dwc3_0_role_switch>;
				};
			};
		};

		connector {
			compatible = "usb-c-connector";
			label = "USB-C";
			data-role = "dual";
			power-role = "dual";
			try-power-role = "sink";
			op-sink-microwatt = <1000000>;
			sink-pdos = <0x401912c 0x403c12c 0x406412c>;
			source-pdos = <0x401912c>;

			altmodes {
				#address-cells = <1>;
				#size-cells = <0>;

				altmode@0 {
					reg = <0>;
					svid = <0xff01>;
					vdo = <0xffffffff>;
				};
			};

			ports {
				#address-cells = <1>;
				#size-cells = <0>;

				port@0 {
					reg = <0>;

					usbc0_orien_sw: endpoint {
						remote-endpoint = <&usbdp_phy0_orientation_switch>;
					};
				};

				port@1 {
					reg = <1>;

					dp_altmode_mux: endpoint {
						remote-endpoint = <&usbdp_phy0_dp_altmode_mux>;
					};
				};
			};
		};
	};

	hdmi_switch: hdmi-switch@18 {
		compatible = "gs_stk8baxx";
		reg = <0x18>;
		status = "okay";
		pinctrl-names = "default";
		pinctrl-0 = <&ba58_irq_gpio>;
		irq-gpio = <&gpio4 RK_PB7 GPIO_ACTIVE_LOW>;
		type = <2>;
		irq_enable = <0>;
		poll_delay_ms = <30>;
		power-off-in-suspend = <1>;
		layout = <7>;
	};
};

&i2s1_8ch {
	pinctrl-names = "default";
	pinctrl-0 = <&i2s1m0_lrck
		     &i2s1m0_sclk
		     &i2s1m0_sdi0
		     &i2s1m0_sdi2
		     &i2s1m0_sdo0>;
	status = "okay";
};

&i2s5_8ch {
	status = "okay";
};

&i2s6_8ch {
	status = "okay";
};

&i2s7_8ch {
	status = "okay";
};

&iep {
	status = "okay";
};

&iep_mmu {
	status = "okay";
};

&isp0_mmu {
	status = "okay";
};

&jpegd {
	status = "okay";
};

&jpegd_mmu {
	status = "okay";
};

&jpege0 {
	status = "okay";
};

&jpege0_mmu {
	status = "okay";
};

&jpege1 {
	status = "okay";
};

&jpege1_mmu {
	status = "okay";
};

&jpege2 {
	status = "okay";
};

&jpege2_mmu {
	status = "okay";
};

&jpege3 {
	status = "okay";
};

&jpege3_mmu {
	status = "okay";
};

&jpege_ccu {
	status = "okay";
};

&mdio0 {
	rgmii_phy0: ethernet-phy@1 {
		compatible = "ethernet-phy-ieee802.3-c22";
		reg = <1>;
	};
};

&mipi2_csi2 {
	status = "okay";

	ports {
		#address-cells = <1>;
		#size-cells = <0>;

		port@0 {
			#address-cells = <1>;
			#size-cells = <0>;
			reg = <0>;

			mipi2_csi2_input: endpoint@1 {
				reg = <1>;
				remote-endpoint = <&csidphy0_out>;
			};
		};

		port@1 {
			#address-cells = <1>;
			#size-cells = <0>;
			reg = <1>;

			mipi2_csi2_output: endpoint@0 {
				reg = <0>;
				remote-endpoint = <&cif_mipi2_in>;
			};
		};
	};
};

&mipi0_csi2 {
	status = "okay";

	ports {
		#address-cells = <1>;
		#size-cells = <0>;

		port@0 {
			reg = <0>;
			#address-cells = <1>;
			#size-cells = <0>;

			mipi0_csi2_input: endpoint@1 {
				reg = <1>;
				remote-endpoint = <&dcphy0_out>;
				data-lanes = <1 2 3 4>;
			};
		};

		port@1 {
			reg = <1>;
			#address-cells = <1>;
			#size-cells = <0>;

			mipi0_csi2_output: endpoint@0 {
				reg = <0>;
				remote-endpoint = <&cif_mipi0_in>;
			};
		};
	};
};

/* SoC-wide accelerators are board-independent and are enabled in the factory DTB. */
&mpp_srv {
	status = "okay";
};

&pdm0 {
	pinctrl-names = "default";
	pinctrl-0 = <&pdm0m0_clk &pdm0m0_sdi0 &pdm0m0_sdi2>;
	status = "okay";
};

&pcie2x1l1 {
	reset-gpios = <&gpio1 RK_PA7 GPIO_ACTIVE_HIGH>;
	vpcie3v3-supply = <&vcc_3v3_s3>;
	pinctrl-names = "default";
	pinctrl-0 = <&pcie30x1_perstn>;
	status = "okay";
};

&pcie2x1l2 {
	reset-gpios = <&gpio3 RK_PB7 GPIO_ACTIVE_HIGH>;
	vpcie3v3-supply = <&vcc_3v3_s3>;
	status = "okay";
};

&pinctrl {
	lt6911 {
		lt6911_pins: lt6911-pins {
			rockchip,pins = <3 RK_PA7 RK_FUNC_GPIO &pcfg_pull_none>,
					<2 RK_PC3 RK_FUNC_GPIO &pcfg_pull_none>;
		};
	};

	hdmirx {
		hdmirx_det: hdmirx-det {
			rockchip,pins = <4 RK_PC6 RK_FUNC_GPIO &pcfg_pull_up>;
		};
	};

	ba58 {
		ba58_irq_gpio: ba58-irq-gpio {
			rockchip,pins = <4 RK_PB7 RK_FUNC_GPIO &pcfg_pull_up>;
		};
	};

	camera {
		camera_pwen: camera-pwen {
			rockchip,pins = <1 RK_PA2 RK_FUNC_GPIO &pcfg_pull_none>;
		};

		camera_pdn: camera-pdn {
			rockchip,pins = <1 RK_PB0 RK_FUNC_GPIO &pcfg_pull_none>;
		};

		camera_rst: camera-rst {
			rockchip,pins = <1 RK_PB1 RK_FUNC_GPIO &pcfg_pull_none>;
		};
	};

	edp {
		edp_en: edp-en {
			rockchip,pins = <1 RK_PD0 RK_FUNC_GPIO &pcfg_pull_up>;
		};

		/* Shared touch/panel enable, same pin as edp-en. */
		touch_panel_en: touch-panel-en {
			rockchip,pins = <1 RK_PD0 RK_FUNC_GPIO &pcfg_pull_up>;
		};

		edp_bl_en: edp-bl-en {
			rockchip,pins = <4 RK_PB6 RK_FUNC_GPIO &pcfg_pull_up>;
		};
	};

	5gpin {
		vcc_5g_module_rst_pin: vcc-5g-module-rst-pin {
			rockchip,pins = <2 RK_PC5 RK_FUNC_GPIO &pcfg_pull_up>;
		};

		vcc_5g_dpr_ctrl_pin: vcc-5g-dpr-ctrl-pin {
			rockchip,pins = <3 RK_PD5 RK_FUNC_GPIO &pcfg_pull_up>;
		};
	};

	headphone {
		hp_det: hp-det {
			rockchip,pins = <4 RK_PB3 RK_FUNC_GPIO &pcfg_pull_none>;
		};

		hp_con: hp-con {
			rockchip,pins = <4 RK_PB4 RK_FUNC_GPIO &pcfg_pull_none>;
		};

		spk_ctrl: spk-ctrl {
			rockchip,pins = <4 RK_PB2 RK_FUNC_GPIO &pcfg_pull_none>;
		};

		linein_det: linein-det {
			rockchip,pins = <1 RK_PB6 RK_FUNC_GPIO &pcfg_pull_none>;
		};
	};

	lt9211 {
		lt9211_gpio: lt9211-gpio {
			rockchip,pins = <3 RK_PB4 RK_FUNC_GPIO &pcfg_pull_none>,
					<3 RK_PA6 RK_FUNC_GPIO &pcfg_pull_none>;
		};
	};

	pcie {
		pcie30x1_perstn: pcie30x1-perstn {
			rockchip,pins = <1 RK_PA7 RK_FUNC_GPIO &pcfg_pull_none>;
		};

		vcc3v3_pcie_en: vcc3v3-pcie-en {
			rockchip,pins = <3 RK_PB3 RK_FUNC_GPIO &pcfg_pull_up>;
		};
	};

	lvds {
		lvds_pwren_pin: lvds-pwen-pin {
			rockchip,pins = <3 RK_PB6 RK_FUNC_GPIO &pcfg_pull_none>;
		};
	};

	led {
		led_power_on: led-power-on {
			rockchip,pins = <3 RK_PD0 RK_FUNC_GPIO &pcfg_pull_up>;
		};
	};

	sdmmc {
		sdmmc_pwr: sdmmc-pwr {
			rockchip,pins = <4 RK_PC3 RK_FUNC_GPIO &pcfg_pull_none>;
		};
	};

	type-c {
		usbc0_int: usbc0-int {
			rockchip,pins = <0 RK_PB7 RK_FUNC_GPIO &pcfg_pull_up>;
		};
	};

	usb {
		vcc5v0_usb_en: vcc5v0-usb-en {
			rockchip,pins = <4 RK_PA6 RK_FUNC_GPIO &pcfg_pull_up>;
		};

		vcc5v0_host_en: vcc5v0-host-en {
			rockchip,pins = <3 RK_PA5 RK_FUNC_GPIO &pcfg_pull_up>;
		};

		typec5v_pwren: typec5v-pwren {
			rockchip,pins = <1 RK_PD1 RK_FUNC_GPIO &pcfg_pull_none>;
		};
	};

	wireless-bluetooth {
		bt_reset_gpio: bt-reset-gpio {
			rockchip,pins = <0 RK_PC6 RK_FUNC_GPIO &pcfg_pull_none>;
		};

		bt_wake_gpio: bt-wake-gpio {
			rockchip,pins = <0 RK_PC5 RK_FUNC_GPIO &pcfg_pull_none>;
		};

		bt_wake_host_irq: bt-wake-host-irq {
			rockchip,pins = <0 RK_PA0 RK_FUNC_GPIO &pcfg_pull_up>;
		};

		uart7_gpios: uart7-gpios {
			rockchip,pins = <3 RK_PC2 RK_FUNC_GPIO &pcfg_pull_none>;
		};
	};

	wireless-wlan {
		wifi_host_wake_irq: wifi-host-wake-irq {
			rockchip,pins = <0 RK_PB2 RK_FUNC_GPIO &pcfg_pull_up>;
		};

		wifi_poweren_gpio: wifi-poweren-gpio {
			rockchip,pins = <0 RK_PC4 RK_FUNC_GPIO &pcfg_pull_up>;
		};
	};

	watchdog {
		sgm760b_power: sgm760b-power {
			rockchip,pins = <0 RK_PD3 RK_FUNC_GPIO &pcfg_pull_none>;
		};
	};

	gt9xx {
		vcc1v8_sys_en: vcc1v8-sys-en {
			rockchip,pins = <0 RK_PC0 RK_FUNC_GPIO &pcfg_pull_up>;
		};

		gt9xx_gpios: gt9xx-gpios {
			rockchip,pins = <1 RK_PD3 RK_FUNC_GPIO &pcfg_pull_up>,
					<4 RK_PB0 RK_FUNC_GPIO &pcfg_pull_up>;
		};
	};

	hym8563 {
		hym8563_int: hym8563-int {
			rockchip,pins = <0 RK_PB0 RK_FUNC_GPIO &pcfg_pull_up>;
		};
	};
};

&pwm12 {
	pinctrl-names = "default";
	pinctrl-0 = <&pwm12m0_pins>;
	status = "okay";
};

&pwm2 {
	status = "okay";
};

&pwm6 {
	status = "okay";
};

&rga2 {
	status = "okay";
};

&rga3_0_mmu {
	status = "okay";
};

&rga3_1_mmu {
	status = "okay";
};

&rga3_core0 {
	status = "okay";
};

&rga3_core1 {
	status = "okay";
};

&rkcif {
	status = "okay";
};

&rkcif_mipi_lvds {
	status = "okay";

	port {
		cif_mipi0_in: endpoint {
			data-lanes = <1 2 3 4>;
			remote-endpoint = <&mipi0_csi2_output>;
		};
	};
};

&rkcif_mipi_lvds2 {
	status = "okay";

	port {
		cif_mipi2_in: endpoint {
			data-lanes = <1 2 3 4>;
			remote-endpoint = <&mipi2_csi2_output>;
		};
	};
};

&rkcif_mipi_lvds_sditf {
	status = "okay";
};

&rkcif_mmu {
	status = "okay";
};

&rkisp0 {
	status = "okay";
};

&rkisp0_vir0 {
	status = "okay";
};

&rknpu {
	mem-supply = <&vdd_npu_s0>;
	rknpu-supply = <&vdd_npu_s0>;
	status = "okay";
};

&rknpu_mmu {
	status = "okay";
};

&rkvdec0 {
	status = "okay";
};

&rkvdec0_mmu {
	status = "okay";
};

&rkvdec1 {
	status = "okay";
};

&rkvdec1_mmu {
	status = "okay";
};

&rkvdec_ccu {
	status = "okay";
};

&rkvenc0 {
	status = "okay";
};

&rkvenc0_mmu {
	status = "okay";
};

&rkvenc1 {
	status = "okay";
};

&rkvenc1_mmu {
	status = "okay";
};

&rkvenc_ccu {
	status = "okay";
};

&rockchip_suspend {
	status = "okay";
};

&route_dp0 {
	status = "okay";
};

&route_dsi1 {
	connect = <&vp3_out_dsi1>;
	status = "okay";
};

&route_edp0 {
	connect = <&vp2_out_edp0>;
	status = "okay";
};

&route_hdmi1 {
	connect = <&vp0_out_hdmi1>;
	status = "okay";
};

&saradc {
	vref-supply = <&vcc_1v8_s0>;
	status = "okay";
};

&sdhci {
	bus-width = <8>;
	no-sdio;
	no-sd;
	non-removable;
	mmc-hs400-1_8v;
	mmc-hs400-enhanced-strobe;
	status = "okay";
};

&sdmmc {
	bus-width = <4>;
	cap-mmc-highspeed;
	cap-sd-highspeed;
	disable-wp;
	no-mmc;
	no-sdio;
	sd-uhs-sdr104;
	supports-sd;
	vmmc-supply = <&vcc_sd>;
	vqmmc-supply = <&vccio_sd_s0>;
	status = "okay";
};

&tsadc {
	status = "okay";
};

&u2phy0 {
	status = "okay";
};

&u2phy0_otg {
	phy-supply = <&vbus5v0_typec>;
	rockchip,typec-vbus-det;
	status = "okay";
};

&u2phy1 {
	status = "okay";
};

&u2phy1_otg {
	phy-supply = <&vcc5v0_host>;
	status = "okay";
};

&u2phy2 {
	status = "okay";
};

&u2phy2_host {
	phy-supply = <&vcc5v0_host>;
	status = "okay";
};

&u2phy3 {
	status = "okay";
};

&u2phy3_host {
	phy-supply = <&vcc5v0_host>;
	status = "okay";
};

&uart0 {
	status = "okay";
};

&uart2 {
	pinctrl-names = "default";
	pinctrl-0 = <&uart2m0_xfer>;
};

&uart7 {
	pinctrl-names = "default";
	pinctrl-0 = <&uart7m1_xfer &uart7m1_ctsn>;
	status = "okay";
};

&usb_host0_ehci {
	status = "okay";
};

&usb_host0_ohci {
	status = "okay";
};

&usb_host1_ehci {
	status = "okay";
};

&usb_host1_ohci {
	status = "okay";
};

&usbdp_phy0 {
	orientation-switch;
	svid = <0xff01>;
	sbu1-dc-gpios = <&gpio3 RK_PA0 GPIO_ACTIVE_HIGH>;
	sbu2-dc-gpios = <&gpio1 RK_PB2 GPIO_ACTIVE_HIGH>;
	status = "okay";

	port {
		#address-cells = <1>;
		#size-cells = <0>;

		usbdp_phy0_orientation_switch: endpoint@0 {
			reg = <0>;
			remote-endpoint = <&usbc0_orien_sw>;
		};

		usbdp_phy0_dp_altmode_mux: endpoint@1 {
			reg = <1>;
			remote-endpoint = <&dp_altmode_mux>;
		};
	};
};

&usbdp_phy0_dp {
	status = "okay";
};

&usbdp_phy0_u3 {
	status = "okay";
};

&usbdp_phy1 {
	status = "okay";
};

&usbdp_phy1_u3 {
	status = "okay";
};

&usbdrd3_0 {
	status = "okay";
};

&usbdrd3_1 {
	status = "okay";
};

&usbdrd_dwc3_0 {
	dr_mode = "host";
	extcon = <&u2phy0>;
	usb-role-switch;
	status = "okay";

	port {
		#address-cells = <1>;
		#size-cells = <0>;

		dwc3_0_role_switch: endpoint@0 {
			reg = <0>;
			remote-endpoint = <&usbc0_role_sw>;
		};
	};
};

&usbdrd_dwc3_1 {
	status = "okay";
};

&vdpu {
	status = "okay";
};

&vdpu_mmu {
	status = "okay";
};

&vepu {
	status = "okay";
};

&vop {
	vop-supply = <&vdd_log_s0>;
	status = "okay";
};

&vop_mmu {
	status = "okay";
};
